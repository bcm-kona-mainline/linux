## Documentation/devicetree/bindings/clock/brcm,kona-ccu.yaml
```yaml
# SPDX-License-Identifier: GPL-2.0-only OR BSD-2-Clause
%YAML 1.2
---
$id: http://devicetree.org/schemas/clock/brcm,kona-ccu.yaml#
$schema: http://devicetree.org/meta-schemas/core.yaml#

title: Broadcom Kona family clock control units (CCU)

maintainers:
  - Florian Fainelli <florian.fainelli@broadcom.com>
  - Ray Jui <rjui@broadcom.com>
  - Scott Branden <sbranden@broadcom.com>

description: |
  Broadcom "Kona" style clock control unit (CCU) is a clock provider that
  manages a set of clock signals.

  All available clock IDs are defined in
  - include/dt-bindings/clock/bcm281xx.h for BCM281XX family
  - include/dt-bindings/clock/bcm21664.h for BCM21664 family

properties:
  compatible:
    enum:
      - brcm,bcm11351-aon-ccu
      - brcm,bcm11351-hub-ccu
      - brcm,bcm11351-master-ccu
      - brcm,bcm11351-root-ccu
      - brcm,bcm11351-slave-ccu
      - brcm,bcm21664-aon-ccu
      - brcm,bcm21664-master-ccu
      - brcm,bcm21664-root-ccu
      - brcm,bcm21664-slave-ccu

  reg:
    maxItems: 1

  '#clock-cells':
    const: 1

  clock-output-names:
    minItems: 1
    maxItems: 20

required:
  - compatible
  - reg
  - '#clock-cells'
  - clock-output-names

allOf:
  - if:
      properties:
        compatible:
          contains:
            const: brcm,bcm11351-aon-ccu
    then:
      properties:
        clock-output-names:
          items:
            - const: hub_timer
            - const: pmu_bsc
            - const: pmu_bsc_var
            - const: hub_timer_apb
            - const: pmu_bsc_apb
  - if:
      properties:
        compatible:
          contains:
            const: brcm,bcm11351-hub-ccu
    then:
      properties:
        clock-output-names:
          const: tmon_1m
  - if:
      properties:
        compatible:
          contains:
            const: brcm,bcm11351-master-ccu
    then:
      properties:
        clock-output-names:
          items:
            - const: sdio1
            - const: sdio2
            - const: sdio3
            - const: sdio4
            - const: usb_ic
            - const: hsic2_48m
            - const: hsic2_12m
            - const: sdio1_ahb
            - const: sdio2_ahb
            - const: sdio3_ahb
            - const: sdio4_ahb
            - const: usb_ic_ahb
            - const: hsic2_ahb
            - const: usb_otg_ahb
  - if:
      properties:
        compatible:
          contains:
            enum:
              - brcm,bcm11351-root-ccu
              - brcm,bcm21664-root-ccu
    then:
      properties:
        clock-output-names:
          const: frac_1m
  - if:
      properties:
        compatible:
          contains:
            const: brcm,bcm11351-slave-ccu
    then:
      properties:
        clock-output-names:
          items:
            - const: uartb
            - const: uartb2
            - const: uartb3
            - const: uartb4
            - const: ssp0
            - const: ssp2
            - const: bsc1
            - const: bsc2
            - const: bsc3
            - const: pwm
            - const: uartb_apb
            - const: uartb2_apb
            - const: uartb3_apb
            - const: uartb4_apb
            - const: ssp0_apb
            - const: ssp2_apb
            - const: bsc1_apb
            - const: bsc2_apb
            - const: bsc3_apb
            - const: pwm_apb
  - if:
      properties:
        compatible:
          contains:
            const: brcm,bcm21664-aon-ccu
    then:
      properties:
        clock-output-names:
          items:
            - const: hub_timer
            - const: hub_timer_apb
  - if:
      properties:
        compatible:
          contains:
            const: brcm,bcm21664-master-ccu
    then:
      properties:
        clock-output-names:
          items:
            - const: sdio1
            - const: sdio2
            - const: sdio3
            - const: sdio4
            - const: sdio1_sleep
            - const: sdio2_sleep
            - const: sdio3_sleep
            - const: sdio4_sleep
            - const: sdio1_ahb
            - const: sdio2_ahb
            - const: sdio3_ahb
            - const: sdio4_ahb
            - const: usb_otg_ahb
  - if:
      properties:
        compatible:
          contains:
            const: brcm,bcm21664-slave-ccu
    then:
      properties:
        clock-output-names:
          items:
            - const: uartb
            - const: uartb2
            - const: uartb3
            - const: bsc1
            - const: bsc2
            - const: bsc3
            - const: bsc4
            - const: uartb_apb
            - const: uartb2_apb
            - const: uartb3_apb
            - const: bsc1_apb
            - const: bsc2_apb
            - const: bsc3_apb
            - const: bsc4_apb

additionalProperties: false

examples:
  - |
    clock-controller@3e011000 {
      compatible = "brcm,bcm11351-slave-ccu";
      reg = <0x3e011000 0x0f00>;
      #clock-cells = <1>;
      clock-output-names = "uartb",
                           "uartb2",
                           "uartb3",
                           "uartb4",
                           "ssp0",
                           "ssp2",
                           "bsc1",
                           "bsc2",
                           "bsc3",
                           "pwm",
                           "uartb_apb",
                           "uartb2_apb",
                           "uartb3_apb",
                           "uartb4_apb",
                           "ssp0_apb",
                           "ssp2_apb",
                           "bsc1_apb",
                           "bsc2_apb",
                           "bsc3_apb",
                           "pwm_apb";
    };
...
```

## Documentation/devicetree/bindings/input/brcm,bcm590xx-ponkey.yaml
```yaml
# SPDX-License-Identifier: (GPL-2.0-only OR BSD-2-Clause)
%YAML 1.2
---
$id: http://devicetree.org/schemas/input/brcm,bcm590xx-ponkey.yaml#
$schema: http://devicetree.org/meta-schemas/core.yaml#

title: Broadcom BCM590xx PMU power-on key (PONKEY)

description: |
  This is a part of device tree bindings for the BCM590xx power
  management unit.

  See Documentation/devicetree/bindings/mfd/brcm,bcm590xx.yaml for
  additional information and example.

maintainers:
  - Artur Weber <aweber.kernel@gmail.com>

properties:
  compatible:
    enum:
      - brcm,bcm59054-ponkey
      - brcm,bcm59056-ponkey

  press-debounce-interval-ns:
    description:
      Button press debounce interval in nanoseconds; defaults to 100ms
    default: 100000000
    # 330us, 1.2ms, 10ms, 50ms, 100ms, 500ms, 1000ms, 2000ms
    enum: [ 330, 1200000, 10000000, 50000000, 100000000, 500000000, 1000000000,
            2000000000 ]

  release-debounce-interval-ns:
    description:
      Button release debounce interval in nanoseconds; defaults to 100ms
    default: 100000000
    # 330us, 1.2ms, 10ms, 50ms, 100ms, 500ms, 1000ms, 2000ms
    enum: [ 330, 1200000, 10000000, 50000000, 100000000, 500000000, 1000000000,
            2000000000 ]

required:
  - compatible

additionalProperties: false
```

## Documentation/devicetree/bindings/mfd/brcm,bcm59056.yaml
```yaml
# SPDX-License-Identifier: (GPL-2.0-only OR BSD-2-Clause)
%YAML 1.2
---
$id: http://devicetree.org/schemas/mfd/brcm,bcm59056.yaml#
$schema: http://devicetree.org/meta-schemas/core.yaml#

title: Broadcom BCM590xx Power Management IC

maintainers:
  - Artur Weber <aweber.kernel@gmail.com>

properties:
  compatible:
    enum:
      - brcm,bcm59056

  reg:
    maxItems: 1

  interrupts:
    maxItems: 1

  regulators:
    type: object
    description: Container node for regulators.
    $ref: ../regulator/brcm,bcm59056.yaml

required:
  - compatible
  - reg
  - interrupts

additionalProperties: false

examples:
  - |
    #include <dt-bindings/interrupt-controller/arm-gic.h>

    i2c {
        #address-cells = <1>;
        #size-cells = <0>;

        pmic: bcm59056@8 {
            compatible = "brcm,bcm59056";
            reg = <0x08>;
            interrupts = <GIC_SPI 215 IRQ_TYPE_LEVEL_HIGH>;

            regulators {
                rfldo_reg: rfldo {
                    regulator-min-microvolt = <1200000>;
                    regulator-max-microvolt = <3300000>;
                };
            };
        };
    };
```

## Documentation/devicetree/bindings/regulator/brcm,bcm59054.yaml
```yaml
# SPDX-License-Identifier: (GPL-2.0-only OR BSD-2-Clause)
%YAML 1.2
---
$id: http://devicetree.org/schemas/regulator/brcm,bcm59054.yaml#
$schema: http://devicetree.org/meta-schemas/core.yaml#

title: Broadcom BCM59054 Power Management IC regulators

description: |
  This is a part of device tree bindings for the BCM590XX family of power
  management ICs.

  See also Documentation/devicetree/bindings/mfd/brcm,bcm59056.yaml for
  additional information and example.

maintainers:
  - Artur Weber <aweber.kernel@gmail.com>

# The valid regulator node names for BCM59054 are:
#   rfldo, camldo1, camldo2, simldo1, simldo2, sdldo, sdxldo,
#   mmcldo1, mmcldo2, audldo, micldo, usbldo, vibldo,
#   csr, iosr1, iosr2, mmsr, sdsr1, sdsr2, vsr,
#   gpldo1, gpldo2, gpldo3, tcxldo, lvldo1, lvldo2

patternProperties:
  "^(cam|sim|mmc)ldo[1-2]$":
    type: object
    $ref: /schemas/regulator/regulator.yaml#

  "^(rf|sd|sdx|aud|mic|usb|vib|tcx)ldo$":
    type: object
    $ref: /schemas/regulator/regulator.yaml#

  "^(c|mm|v)sr$":
    type: object
    $ref: /schemas/regulator/regulator.yaml#

  "^(io|sd)sr[1-2]$":
    type: object
    $ref: /schemas/regulator/regulator.yaml#

  "^gpldo[1-3]$":
    type: object
    $ref: /schemas/regulator/regulator.yaml#

  "^lvldo[1-2]$":
    type: object
    $ref: /schemas/regulator/regulator.yaml#

properties:
  "vbus":
    type: object
    $ref: /schemas/regulator/regulator.yaml#

additionalProperties: false
```
